## platform/linux/arch/Kconfig
```kconfig
# SPDX-License-Identifier: GPL-2.0-only
menu "Horn guest options"
config HORN
	def_bool y
config UML
	def_bool y
	select ARCH_HAS_CPU_FINALIZE_INIT
	select ARCH_WANTS_DYNAMIC_TASK_STRUCT
	select HAVE_EXIT_THREAD
	select ARCH_HAS_CACHE_LINE_SIZE
	select ARCH_HAS_STRNCPY_FROM_USER
	select ARCH_HAS_STRNLEN_USER
	select HAVE_ARCH_AUDITSYSCALL
	select HAVE_UID16
	select HAVE_PAGE_SIZE_4KB
	select BUILDTIME_TABLE_SORT
	select NO_DMA
	select GENERIC_IRQ_SHOW
	select GENERIC_CPU_DEVICES
	select HAVE_ARCH_TRACEHOOK
	select HAVE_ARCH_SECCOMP
	select HAVE_ARCH_SECCOMP_FILTER
	select HAVE_SYSCALL_TRACEPOINTS
	select THREAD_INFO_IN_TASK
	select SPARSE_IRQ
config MMU
	def_bool y
config NO_IOMEM
	def_bool y
config ISA
	bool
config SBUS
	bool
config LOCKDEP_SUPPORT
	def_bool y
config STACKTRACE_SUPPORT
	def_bool y
	select STACKTRACE
config GENERIC_CALIBRATE_DELAY
	def_bool y
config HZ
	int
	default 100
config NR_CPUS
	int
	default 1
config KERNEL_STACK_ORDER
	int
	default 2
config PGTABLE_LEVELS
	int
	default 4
config 64BIT
 def_bool y
config X86_64
 def_bool y
 select MODULES_USE_ELF_RELA
config UML_X86
 def_bool y
 select DCACHE_WORD_ACCESS
 select HAVE_EFFICIENT_UNALIGNED_ACCESS
config GENERIC_HWEIGHT
 def_bool y
source "arch/x86/Kconfig.cpu"
config HORN_CONSOLE
	def_bool y
	select HVC_DRIVER
	select TTY
endmenu
```

## platform/linux/arch/configs/defconfig
```kconfig
CONFIG_64BIT=y
CONFIG_X86_64=y
# x86-64 only: ARCH=horn defines no IA32 or x32 compatibility option.
# CONFIG_IA32_EMULATION is not set
# CONFIG_X86_X32_ABI is not set
# CONFIG_COMPAT is not set
CONFIG_EXPERT=y
CONFIG_PRINTK=y
CONFIG_BUG=y
CONFIG_BINFMT_ELF=y
CONFIG_BLK_DEV_INITRD=y
CONFIG_INITRAMFS_SOURCE=""
CONFIG_TTY=y
CONFIG_HVC_DRIVER=y
CONFIG_HORN_CONSOLE=y
CONFIG_DEVTMPFS=y
CONFIG_DEVTMPFS_MOUNT=y
CONFIG_PROC_FS=y
CONFIG_SYSFS=y
CONFIG_TMPFS=y
CONFIG_UNIX=y
CONFIG_MULTIUSER=y
CONFIG_POSIX_TIMERS=y
CONFIG_HIGH_RES_TIMERS=y
CONFIG_NO_HZ_IDLE=y
CONFIG_EPOLL=y
CONFIG_FUTEX=y
CONFIG_IKCONFIG=n
CONFIG_MODULES=n
CONFIG_LOCALVERSION="-horn"
CONFIG_LOCALVERSION_AUTO=n
CONFIG_CC_OPTIMIZE_FOR_SIZE=y
CONFIG_LOG_BUF_SHIFT=17
CONFIG_STACKTRACE=y
CONFIG_DEBUG_KERNEL=y
CONFIG_RCU_CPU_STALL_TIMEOUT=60
```
